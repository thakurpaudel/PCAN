## esp32s3/main/Kconfig.projbuild
```kconfig
menu "PCAN Firmware Configuration"

    config PCAN_TX_PIN
        int "CAN TX GPIO Pin"
        default 1
        help
            GPIO pin number for CAN TX (TWAI).

    config PCAN_RX_PIN
        int "CAN RX GPIO Pin"
        default 2
        help
            GPIO pin number for CAN RX (TWAI).

    config PCAN_USB_LINK_LED_PIN
        int "USB link/status LED GPIO Pin"
        default 8
        help
            GPIO pin for the USB/PEAK driver link status LED. Set to -1 to disable.

    config PCAN_CAN_ACTIVITY_LED_PIN
        int "CAN activity LED GPIO Pin"
        default 9
        help
            GPIO pin for CAN RX/TX activity LED. Set to -1 to disable.

    config PCAN_LED_ACTIVE_LOW
        bool "LEDs are active low"
        default n
        help
            Enable this if the LED turns on when the GPIO output is low.

    config PCAN_MANUFACTURER
        string "USB Manufacturer String"
        default "PEAK-System"
        help
            The manufacturer string descriptor for the USB device.

    config PCAN_DEVICE_NAME
        string "USB Device Name (Product String)"
        default "PCAN-USB FD"
        help
            The product string descriptor for the USB device.

    config PCAN_SERIAL_NUMBER
        string "USB Serial Number"
        default ""
        help
            The serial number string descriptor for the USB device.

    config PCAN_USB_VID
        hex "USB Vendor ID (VID)"
        default 0x0C72
        help
            The Vendor ID (VID) for the USB device. Default is 0x0C72 (PEAK-System).

    config PCAN_USB_PID
        hex "USB Product ID (PID)"
        default 0x0012
        help
            The Product ID (PID) for the USB device. Default is 0x0012 (PCAN-USB FD, single CAN channel).

endmenu
```

## esp32s3/sdkconfig.defaults
```kconfig
# Enable USB OTG
CONFIG_USB_OTG_SUPPORTED=y

# TWAI Configuration
CONFIG_TWAI_ISR_IN_IRAM=y
CONFIG_PCAN_USB_LINK_LED_PIN=8
CONFIG_PCAN_CAN_ACTIVITY_LED_PIN=9
# CONFIG_PCAN_LED_ACTIVE_LOW is not set

# FreeRTOS config for faster response
CONFIG_FREERTOS_HZ=1000

# Compiler options
CONFIG_COMPILER_OPTIMIZATION_PERF=y
```

## tests/esp32_can_test/main/Kconfig.projbuild
```kconfig
menu "ESP32 CAN Test Configuration"

    config TEST_CAN_TX_PIN
        int "CAN TX GPIO Pin"
        default 14
        help
            GPIO pin number for CAN TX (TWAI).

    config TEST_CAN_RX_PIN
        int "CAN RX GPIO Pin"
        default 13
        help
            GPIO pin number for CAN RX (TWAI).

    config TEST_STATUS_LED_PIN
        int "Status LED GPIO Pin"
        default 17
        help
            GPIO pin number for the Status LED. Set to -1 to disable.

    config TEST_CAN_BITRATE_K
        int "CAN Bitrate (kbps)"
        default 250
        help
            CAN bitrate in kbps (e.g. 125, 250, 500, 1000).

    config TEST_CAN_TX_INTERVAL_MS
        int "CAN Transmission Interval (ms)"
        default 1000
        help
            How often to send a test CAN frame, in milliseconds.

    config TEST_CAN_TX_MSG_ID
        hex "CAN Test Message ID"
        default 0x100
        help
            The arbitration ID of the sent test message.

endmenu
```
